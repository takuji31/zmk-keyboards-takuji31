## boards/shields/nazuna4/Kconfig.defconfig
```kconfig
if SHIELD_NAZUNA4

config ZMK_KEYBOARD_NAME
    default "nazuna4"

endif # SHIELD_NAZUNA4
```

## boards/shields/nazuna49/Kconfig.defconfig
```kconfig
if SHIELD_NAZUNA49_RIGHT

config ZMK_KEYBOARD_NAME
    default "nazuna49"

config ZMK_SPLIT_ROLE_CENTRAL
    default y

endif # SHIELD_NAZUNA49_LEFT

if SHIELD_NAZUNA49_LEFT || SHIELD_NAZUNA49_RIGHT

config ZMK_SPLIT
    default y

endif # SHIELD_NAZUNA49_LEFT || SHIELD_NAZUNA49_RIGHT
```

## boards/shields/nazuna49/Kconfig.shield
```kconfig
config SHIELD_NAZUNA49_LEFT
    def_bool $(shields_list_contains,nazuna49_left)

config SHIELD_NAZUNA49_RIGHT
    def_bool $(shields_list_contains,nazuna49_right)
```

## boards/shields/nazuna50/Kconfig.defconfig
```kconfig
if SHIELD_NAZUNA50_LEFT

config ZMK_KEYBOARD_NAME
    default "nazuna50"

config ZMK_SPLIT_ROLE_CENTRAL
    default y

endif # SHIELD_NAZUNA50_LEFT

if SHIELD_NAZUNA50_LEFT || SHIELD_NAZUNA50_RIGHT

config ZMK_SPLIT
    default y

endif # SHIELD_NAZUNA50_LEFT || SHIELD_NAZUNA50_RIGHT
```

## boards/shields/nazuna50/Kconfig.shield
```kconfig
config SHIELD_NAZUNA50_LEFT
    def_bool $(shields_list_contains,nazuna50_left)

config SHIELD_NAZUNA50_RIGHT
    def_bool $(shields_list_contains,nazuna50_right)
```
